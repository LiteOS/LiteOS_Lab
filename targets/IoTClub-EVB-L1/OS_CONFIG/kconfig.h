## targets/STM32F429IGTx_FIRE/Kconfig
```kconfig
#
# Copyright (c) [2020] Huawei Technologies Co.,Ltd.All rights reserved.
#
# LiteOS NOVA is licensed under the Mulan PSL v1.
# You can use this software according to the terms and conditions of the Mulan PSL v1.
# You may obtain a copy of Mulan PSL v1 at:
#
#   http://license.coscl.org.cn/MulanPSL
#
# THIS SOFTWARE IS PROVIDED ON AN "AS IS" BASIS, WITHOUT WARRANTIES OF ANY KIND, EITHER
# EXPRESS OR IMPLIED, INCLUDING BUT NOT LIMITED TO NON-INFRINGEMENT, MERCHANTABILITY OR
# FIT FOR A PARTICULAR PURPOSE.
# See the Mulan PSL v1 for more details.
#

menu "LiteOS for STM32F429IGTx_FIRE Project configuration For IoT Link"

comment "This is a demo project and hope you enjoy it"

config ARCH_CPU_TYPE
   string "Select the cpu arch:armv7-m armv6-m riscv32 x86-64"
   default "armv7-m" 
   
choice 
    prompt "Uart2/3 reuse PB11 PA2 WITH ETHERNET MAC"
    config PB11PA2_NONE
        bool  "Not Used"
    config PB11PA2_UARTAT
        bool "Enable PB11PA2 AS UART"
    config PB11PA2_MAC
        bool "Enable PN11PA2 AS MAC" 
endchoice   

if PB11PA2_UARTAT    
    config UARTAT_RCVMAX
        int  "Config the at uart receive buffer size"
        default 2048
    
    config UARTAT_BAUDRATE
        int  "Config the at uart baud rate"
        default 115200
        
    config UARTAT_DEVNAME
        string "Config the at uart device name"
        default "atdev"
endif

config OTA_APP_ENABLE
    bool "Enable the ota app"
    default n
    select OTA_ENABLE
      
    
config OTA_LOADER_ENABLE
    bool "Enable the ota loader"
    default n
    select OTA_ENABLE
    select OTA_PATCH    
          
rsource "../../iot_link/Kconfig"
    
endmenu
```

## targets/STM32L431VCT6_Bossay/Kconfig
```kconfig
#
# Copyright (c) [2020] Huawei Technologies Co.,Ltd.All rights reserved.
#
# LiteOS NOVA is licensed under the Mulan PSL v1.
# You can use this software according to the terms and conditions of the Mulan PSL v1.
# You may obtain a copy of Mulan PSL v1 at:
#
#   http://license.coscl.org.cn/MulanPSL
#
# THIS SOFTWARE IS PROVIDED ON AN "AS IS" BASIS, WITHOUT WARRANTIES OF ANY KIND, EITHER
# EXPRESS OR IMPLIED, INCLUDING BUT NOT LIMITED TO NON-INFRINGEMENT, MERCHANTABILITY OR
# FIT FOR A PARTICULAR PURPOSE.
# See the Mulan PSL v1 for more details.
#

menu "LiteOS for STM32L431_BearPi Project configuration For IoT Link"

comment "This is a demo project and hope you enjoy it"

config ARCH_CPU_TYPE
   string "Select the cpu arch:armv7-m armv6-m riscv32 x86-64"
   default "armv7-m"
   
config UARTAT_RCVMAX
    int  "Config the at uart receive buffer size"
    default 2048

config UARTAT_BAUDRATE
    int  "Config the at uart baud rate"
    default 9600
    
config UARTAT_DEVNAME
    string "Config the at uart device name"
    default "atdev"
          
rsource "../../iot_link/Kconfig"


choice Demo
    optional
    prompt "User Defined Demo"
    config Demo_None
        bool "none"
    config Demo_Helloworld
        bool "Hello World"
        select SHELL_ENABLE
    config Demo_Streetlight
        bool "OC Streetlight"
        select OC_LWM2M
        select SHELL_ENABLE
        select AT_ENABLE
        select BOUDICA150
        select STIMER_ENABLE
    config Demo_Agriculture
        bool "OC Agriculture"
        select OC_LWM2M
        select SHELL_ENABLE
        select AT_ENABLE
        select BOUDICA150
        select STIMER_ENABLE
    config Demo_Track
        bool "OC Track"
        select OC_LWM2M
        select SHELL_ENABLE
        select AT_ENABLE
        select BOUDICA150
        select STIMER_ENABLE
    config Demo_Smoke
        bool "OC Smoke"
        select OC_LWM2M
        select SHELL_ENABLE
        select AT_ENABLE
        select BOUDICA150
        select STIMER_ENABLE
    config Demo_OC_Cloud_Map
        bool "OC Cloud Map"
        select OC_LWM2M
        select SHELL_ENABLE
        select AT_ENABLE
        select BOUDICA150
        select STIMER_ENABLE
endchoice

config USER_DEMO
    string
    default "hello_world_demo" if Demo_Helloworld
    default "oc_streetlight_template" if Demo_Streetlight
    default "oc_agriculture_template" if Demo_Agriculture
    default "oc_track_template" if Demo_Track
    default "oc_smoke_template" if Demo_Smoke
    default "oc_cloud_map_demo" if Demo_OC_Cloud_Map
    default "none"

        
endmenu
```

## targets/STM32L431_BearPi_OS_Func/Demos/Kconfig
```kconfig
choice Demo
	optional
	prompt "User Defined Demo"
	config Demo_None
		bool "none"
	config Demo_Helloworld
		bool "Hello World"
		select SHELL_ENABLE
	config Osal_Task_Demo
		bool "Osal Task"
		select SHELL_ENABLE
	config Osal_Men_Demo
		bool "Osal Mem"
		select SHELL_ENABLE
	config Osal_Semp_Demo
		bool "Osal Semp"
		select SHELL_ENABLE
	config Osal_Mutex_Demo
		bool "Osal Mutex"
		select SHELL_ENABLE

endchoice

config USER_DEMO
	string
	default "hello_world_demo" if Demo_Helloworld
	default "osal_task_demo" if Osal_Task_Demo
	default "osal_mem_demo" if Osal_Men_Demo
	default "osal_semp_demo" if Osal_Semp_Demo	
	default "osal_mutex_demo" if Osal_Mutex_Demo
	default "none"
```

## targets/STM32L431_BearPi_OS_Func/Kconfig
```kconfig
#
# Copyright (c) [2020] Huawei Technologies Co.,Ltd.All rights reserved.
#
# LiteOS NOVA is licensed under the Mulan PSL v1.
# You can use this software according to the terms and conditions of the Mulan PSL v1.
# You may obtain a copy of Mulan PSL v1 at:
#
#   http://license.coscl.org.cn/MulanPSL
#
# THIS SOFTWARE IS PROVIDED ON AN "AS IS" BASIS, WITHOUT WARRANTIES OF ANY KIND, EITHER
# EXPRESS OR IMPLIED, INCLUDING BUT NOT LIMITED TO NON-INFRINGEMENT, MERCHANTABILITY OR
# FIT FOR A PARTICULAR PURPOSE.
# See the Mulan PSL v1 for more details.
#

menu "LiteOS for STM32L431_BearPi Project configuration For IoT Link"

comment "This is a demo project and hope you enjoy it"

config ARCH_CPU_TYPE
   string "Select the cpu arch:armv7-m armv6-m riscv32 x86-64"
   default "armv7-m"
   
config UARTAT_RCVMAX
    int  "Config the at uart receive buffer size"
    default 2048

config UARTAT_BAUDRATE
    int  "Config the at uart baud rate"
    default 9600
    
config UARTAT_DEVNAME
    string "Config the at uart device name"
    default "atdev"
          
rsource "../../iot_link/Kconfig"

choice Demo
	optional
	prompt "User Defined Demo"
	config Demo_None
		bool "none"
	config Demo_Helloworld
		bool "Hello World"
		select SHELL_ENABLE
	config Osal_Task_Demo
		bool "Osal Task"
		select SHELL_ENABLE
	config Osal_Men_Demo
		bool "Osal Mem"
		select SHELL_ENABLE
	config Osal_Semp_Demo
		bool "Osal Semp"
		select SHELL_ENABLE
	config Osal_Mutex_Demo
		bool "Osal Mutex"
		select SHELL_ENABLE
	config Osal_Interrupt_Demo
		bool "Osal_Interrupt"
		select SHELL_ENABLE

endchoice

config USER_DEMO
	string
	default "hello_world_demo" if Demo_Helloworld
	default "osal_task_demo" if Osal_Task_Demo
	default "osal_mem_demo" if Osal_Men_Demo
	default "osal_semp_demo" if Osal_Semp_Demo	
	default "osal_mutex_demo" if Osal_Mutex_Demo
	default "osal_interrupt_demo" if Osal_Interrupt_Demo
	default "none"

        
endmenu
```

## targets/STM32L476RG_NB476/Demos/Kconfig
```kconfig
choice Demo
	optional
	prompt "User Defined Demo"
	config Demo_None
		bool "none"
	config Demo_Use_Coap
		bool "Report temperature"
endchoice

config USER_DEMO
	string
	default "use_coap_demo" if Demo_Use_Coap
	default "none"
```

## targets/STM32L476RG_NB476/Kconfig
```kconfig
#
# Copyright (c) [2020] Huawei Technologies Co.,Ltd.All rights reserved.
#
# LiteOS NOVA is licensed under the Mulan PSL v1.
# You can use this software according to the terms and conditions of the Mulan PSL v1.
# You may obtain a copy of Mulan PSL v1 at:
#
#   http://license.coscl.org.cn/MulanPSL
#
# THIS SOFTWARE IS PROVIDED ON AN "AS IS" BASIS, WITHOUT WARRANTIES OF ANY KIND, EITHER
# EXPRESS OR IMPLIED, INCLUDING BUT NOT LIMITED TO NON-INFRINGEMENT, MERCHANTABILITY OR
# FIT FOR A PARTICULAR PURPOSE.
# See the Mulan PSL v1 for more details.
#

menu "LiteOS for STM32L476_NB476 Project configuration For IoT Link"

comment "This is a demo project and hope you enjoy it"

config ARCH_CPU_TYPE
   string "Select the cpu arch:armv7-m armv6-m riscv32 x86-64"
   default "armv7-m"
   
config UARTAT_RCVMAX
    int  "Config the at uart receive buffer size"
    default 2048

config UARTAT_BAUDRATE
    int  "Config the at uart baud rate"
    default 9600
    
config UARTAT_DEVNAME
    string "Config the at uart device name"
    default "atdev"
          
rsource "../../iot_link/Kconfig"


choice Demo
    optional
    prompt "User Defined Demo"
    config Demo_None
        bool "none"
	config Demo_Use_Coap
     	bool "Report temperature"
         select OC_COAP
         select SHELL_ENABLE
         select AT_ENABLE
         select BOUDICA120
endchoice

config USER_DEMO
    string
	default "use_coap_demo" if Demo_Use_Coap
    default "none"

        
endmenu
```

## test/llt/cmockery/novaos/case/kconfig
```kconfig
#
# Copyright (c) [2019] Huawei Technologies Co.,Ltd.All rights reserved.
#
# LiteOS NOVA is licensed under the Mulan PSL v1.
# You can use this software according to the terms and conditions of the Mulan PSL v1.
# You may obtain a copy of Mulan PSL v1 at:
#
# 	http://license.coscl.org.cn/MulanPSL
#
# THIS SOFTWARE IS PROVIDED ON AN "AS IS" BASIS, WITHOUT WARRANTIES OF ANY KIND, EITHER
# EXPRESS OR IMPLIED, INCLUDING BUT NOT LIMITED TO NON-INFRINGEMENT, MERCHANTABILITY OR
# FIT FOR A PARTICULAR PURPOSE.
# See the Mulan PSL v1 for more details.
#

menu "LiteOS NOVA tests, cases"

config TESTER
    bool "tester code"
    default n

config MUTEX_CASE
    bool "mutex test code"
    depends on TESTER
    default n

config SEM_CASE
    bool "sem test code"
    depends on TESTER
    default n

config EVENT_CASE
    bool "event test code"
    depends on TESTER
    default n

config MQ_CASE
    bool "msg queue test code"
    depends on TESTER
    default n

config TIMER_CASE
    bool "timer test code"
    depends on TESTER
    default n

config TASK_CASE
    bool "task test code"
    depends on TESTER
    default n

config HOOK_CASE
    bool "task hook test code"
    depends on TESTER
    select TASK_CREATE_HOOK
    select TASK_DELETE_HOOK
    select TASK_SWITCH_HOOK
    default n

config TLS_CASE
    bool "task local storage test code"
    depends on TESTER
    select TASK_TLS
    default n

config DEFER_CASE
    bool "defer call test code"
    depends on TESTER
    default n

config MEMTRY_CASE
    bool "memory try test code"
    depends on TESTER
    default n

config MEMPOOL_CASE
    bool "memory pool test code"
    depends on TESTER
    default n

config HEAP_CASE
    bool "heap test code"
    depends on TESTER
    default n

endmenu
```
