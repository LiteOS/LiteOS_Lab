## iot_link/os/novaos/core/kernel/kconfig
```kconfig
#
# Copyright (c) [2019] Huawei Technologies Co.,Ltd.All rights reserved.
#
# LiteOS NOVA is licensed under the Mulan PSL v1.
# You can use this software according to the terms and conditions of the Mulan PSL v1.
# You may obtain a copy of Mulan PSL v1 at:
#
# 	http://license.coscl.org.cn/MulanPSL
#
# THIS SOFTWARE IS PROVIDED ON AN "AS IS" BASIS, WITHOUT WARRANTIES OF ANY KIND, EITHER
# EXPRESS OR IMPLIED, INCLUDING BUT NOT LIMITED TO NON-INFRINGEMENT, MERCHANTABILITY OR
# FIT FOR A PARTICULAR PURPOSE.
# See the Mulan PSL v1 for more details.
#

menu "LiteOS NOVA kernel configuration"

#
# critical settings
#

choice
    prompt "Please select the number of slots in critical job."
    default NR_CRITICAL_JOB_Q_SLOTS_32
config NR_CRITICAL_JOB_Q_SLOTS_8
    bool "8"
config NR_CRITICAL_JOB_Q_SLOTS_16
    bool "16"
config NR_CRITICAL_JOB_Q_SLOTS_32
    bool "32"
config NR_CRITICAL_JOB_Q_SLOTS_64
    bool "64"
endchoice

config NR_CRITICAL_JOB_Q_SLOTS
    int
    default  8 if NR_CRITICAL_JOB_Q_SLOTS_8
    default 16 if NR_CRITICAL_JOB_Q_SLOTS_16
    default 32 if NR_CRITICAL_JOB_Q_SLOTS_32
    default 64 if NR_CRITICAL_JOB_Q_SLOTS_64

config CRITICAL_STACK_SIZE
    hex "The size of critical job stack."
    default 0x800

config CRITICAL_STACK_CHECK
    bool "Enable critical stack overflow check."
    default y

#
# event settings
#

config IPC_EVENT
    bool "Enable the IPC event."
    default y

#
# message queue settings
#

config IPC_MQ
    bool "Enable the IPC message queue."
    default y

#
# task settings
#

config TASK_PRIO_64
    bool "Enable 64 task priorities support."

#
# task hook support
#

config TASK_HOOK
    def_bool n

#
# task create hook support
#

config TASK_CREATE_HOOK
    bool  "Task create hook support."
    select TASK_HOOK
    default n

#
# number of task create hook table slots
#

config NR_TASK_CREATE_HOOK_SLOTS
    int "The number of task create hook table slots."
    range 1 4
    default 4
    depends on TASK_CREATE_HOOK

#
# task delete hook support
#

config TASK_DELETE_HOOK
    bool  "Task delete hook support."
    select TASK_HOOK
    default n

#
# number of task delete hook table slots
#

config NR_TASK_DELETE_HOOK_SLOTS
    int "The number of task delete hook table slots."
    range 1 4
    default 4
    depends on TASK_DELETE_HOOK

#
# task settings
#

config TASK_SWITCH_HOOK
    bool "Enable task switch hook."
    select TASK_HOOK
    default y

#
# number of task switch hook table slots
#

config NR_TASK_SWITCH_HOOK_SLOTS
    int "The number of task switch hook table slots."
    range 1 4
    depends on TASK_SWITCH_HOOK
    default 4

#
# task local storage support
#

config TASK_TLS
    bool "Task local storage support."
    default n

#
# number of TLS (task local storage) slots
#

config NR_TLS_SLOTS
    int "The number of TLS (task local storage) slots."
    range 1 8
    default 4
    depends on TASK_TLS

#
# tick settings
#

choice
    prompt "Please select the number of slots in the tick queue array. The tick queue is divided to reduce the insertion time. The divided queue is held in an array."
    default NR_TICK_Q_SLOTS_16
config NR_TICK_Q_SLOTS_8
    bool "8"
config NR_TICK_Q_SLOTS_16
    bool "16"
config NR_TICK_Q_SLOTS_32
    bool "32"
config NR_TICK_Q_SLOTS_64
    bool "64"
endchoice

config NR_TICK_Q_SLOTS_ORDER
    int
    default 3 if NR_TICK_Q_SLOTS_8
    default 4 if NR_TICK_Q_SLOTS_16
    default 5 if NR_TICK_Q_SLOTS_32
    default 6 if NR_TICK_Q_SLOTS_64

config TICK_TIMER_NAME
    string "the system tick timer name"
    default ""

config SYS_TICK_HZ
    int "the system tick frequent"
    range 10 10000
    default 50

config NR_RR_SLICING_TICKS
    int "The time slice size used in the round-robin scheduling."
    range 1 SYS_TICK_HZ
    default 5

config TICKLESS
    bool "Enable tickless support."
    default n

config TICK_DEBUG
    def_bool y

#
# software timer settings
#

config SOFT_TIMER
    bool "Enable the software timer support."
    default y

#
# deferred job settings
#

config DEFERRED_STACK_SIZE
    hex "The stack size of the deferred task."
    default 0x800

config DEFERRED_NAME
    string "The task name of the deferred task."
    default "defer"

endmenu
```

## iot_link/os/novaos/core/mem/kconfig
```kconfig
#
# Copyright (c) [2019] Huawei Technologies Co.,Ltd.All rights reserved.
#
# LiteOS NOVA is licensed under the Mulan PSL v1.
# You can use this software according to the terms and conditions of the Mulan PSL v1.
# You may obtain a copy of Mulan PSL v1 at:
#
# 	http://license.coscl.org.cn/MulanPSL
#
# THIS SOFTWARE IS PROVIDED ON AN "AS IS" BASIS, WITHOUT WARRANTIES OF ANY KIND, EITHER
# EXPRESS OR IMPLIED, INCLUDING BUT NOT LIMITED TO NON-INFRINGEMENT, MERCHANTABILITY OR
# FIT FOR A PARTICULAR PURPOSE.
# See the Mulan PSL v1 for more details.
#

menu "LiteOS NOVA heap configurations"

config MMU
    def_bool n

config HEAP_DEBUG
    bool "Enable heap debug support."
    default n

choice
    prompt "Select Dynamic Storage Allocation algorithm"
    default BESTFIT
config BESTFIT
    bool "bestfit algorithm"
config TLSF
    bool "Two-Level Segregate Fit (TLSF) algorithm"
endchoice

if TLSF

choice
    prompt "max size of the memory blocks managed by the TLSF heap"
    default MAX_TLSF_BLOCK_001M

config MAX_TLSF_BLOCK_008K
    bool "max size of 8KB"
config MAX_TLSF_BLOCK_016K
    bool "max size of 16KB"
config MAX_TLSF_BLOCK_032K
    bool "max size of 32KB"
config MAX_TLSF_BLOCK_064K
    bool "max size of 64KB"
config MAX_TLSF_BLOCK_128K
    bool "max size of 128KB"
config MAX_TLSF_BLOCK_256K
    bool "max size of 256KB"
config MAX_TLSF_BLOCK_512K
    bool "max size of 512KB"
config MAX_TLSF_BLOCK_001M
    bool "max size of 1MB"
config MAX_TLSF_BLOCK_002M
    bool "max size of 2MB"
config MAX_TLSF_BLOCK_004M
    bool "max size of 4MB"
config MAX_TLSF_BLOCK_008M
    bool "max size of 8MB"
config MAX_TLSF_BLOCK_016M
    bool "max size of 16MB"
config MAX_TLSF_BLOCK_032M
    bool "max size of 32MB"
config MAX_TLSF_BLOCK_064M
    bool "max size of 64MB"
config MAX_TLSF_BLOCK_128M
    bool "max size of 128MB"
config MAX_TLSF_BLOCK_256M
    bool "max size of 256MB"
config MAX_TLSF_BLOCK_512M
    bool "max size of 512MB"
config MAX_TLSF_BLOCK_001G
    bool "max size of 1GB"
config MAX_TLSF_BLOCK_002G
    bool "max size of 2GB"
endchoice

config FL_IDX_MAX
    int
    default 13 if MAX_TLSF_BLOCK_008K
    default 14 if MAX_TLSF_BLOCK_016K
    default 15 if MAX_TLSF_BLOCK_032K
    default 16 if MAX_TLSF_BLOCK_064K
    default 17 if MAX_TLSF_BLOCK_128K
    default 18 if MAX_TLSF_BLOCK_256K
    default 19 if MAX_TLSF_BLOCK_512K
    default 20 if MAX_TLSF_BLOCK_001M
    default 21 if MAX_TLSF_BLOCK_002M
    default 22 if MAX_TLSF_BLOCK_004M
    default 23 if MAX_TLSF_BLOCK_008M
    default 24 if MAX_TLSF_BLOCK_016M
    default 25 if MAX_TLSF_BLOCK_032M
    default 26 if MAX_TLSF_BLOCK_064M
    default 27 if MAX_TLSF_BLOCK_128M
    default 28 if MAX_TLSF_BLOCK_256M
    default 29 if MAX_TLSF_BLOCK_512M
    default 30 if MAX_TLSF_BLOCK_001G
    default 31 if MAX_TLSF_BLOCK_002G

endif       # end if TLSF

config MEM_STATISTICS
    bool "memory statistics enable"
    default y

config PAGE_POOL
    def_bool n

config MEMPOOL
    bool "Enable memory pool support."
    default y

endmenu     # end menu of heap
```

## iot_link/os/novaos/core/services/kconfig
```kconfig
#
# Copyright (c) [2019] Huawei Technologies Co.,Ltd.All rights reserved.
#
# LiteOS NOVA is licensed under the Mulan PSL v1.
# You can use this software according to the terms and conditions of the Mulan PSL v1.
# You may obtain a copy of Mulan PSL v1 at:
#
# 	http://license.coscl.org.cn/MulanPSL
#
# THIS SOFTWARE IS PROVIDED ON AN "AS IS" BASIS, WITHOUT WARRANTIES OF ANY KIND, EITHER
# EXPRESS OR IMPLIED, INCLUDING BUT NOT LIMITED TO NON-INFRINGEMENT, MERCHANTABILITY OR
# FIT FOR A PARTICULAR PURPOSE.
# See the Mulan PSL v1 for more details.
#

config SYSCALL
    def_bool n

config PROFILE
    def_bool n
    select TASK_TLS
    select TASK_CREATE_HOOK
    select TASK_DELETE_HOOK
    select TASK_SWITCH_HOOK
```

## iot_link/os/novaos/kconfig
```kconfig
#
# Copyright (c) [2019] Huawei Technologies Co.,Ltd.All rights reserved.
#
# LiteOS NOVA is licensed under the Mulan PSL v1.
# You can use this software according to the terms and conditions of the Mulan PSL v1.
# You may obtain a copy of Mulan PSL v1 at:
#
# 	http://license.coscl.org.cn/MulanPSL
#
# THIS SOFTWARE IS PROVIDED ON AN "AS IS" BASIS, WITHOUT WARRANTIES OF ANY KIND, EITHER
# EXPRESS OR IMPLIED, INCLUDING BUT NOT LIMITED TO NON-INFRINGEMENT, MERCHANTABILITY OR
# FIT FOR A PARTICULAR PURPOSE.
# See the Mulan PSL v1 for more details.
#

mainmenu "LiteOS NOVA configuration"

rsource "arch/kconfig"
rsource "components/kconfig"
rsource "core/kconfig"
rsource "test/kconfig"
rsource "utils/kconfig"
```

## iot_link/os/novaos/target/board/stm32f4_fire/kconfig
```kconfig
#
# Copyright (c) [2019] Huawei Technologies Co.,Ltd.All rights reserved.
#
# LiteOS NOVA is licensed under the Mulan PSL v1.
# You can use this software according to the terms and conditions of the Mulan PSL v1.
# You may obtain a copy of Mulan PSL v1 at:
#
# 	http://license.coscl.org.cn/MulanPSL
#
# THIS SOFTWARE IS PROVIDED ON AN "AS IS" BASIS, WITHOUT WARRANTIES OF ANY KIND, EITHER
# EXPRESS OR IMPLIED, INCLUDING BUT NOT LIMITED TO NON-INFRINGEMENT, MERCHANTABILITY OR
# FIT FOR A PARTICULAR PURPOSE.
# See the Mulan PSL v1 for more details.
#

config STM32F4_FIRE
    def_bool n
    select STM32F4

config SOC
    def_string "stm32f429igtx"
```

## iot_link/os/novaos/target/kconfig
```kconfig
#
# Copyright (c) [2019] Huawei Technologies Co.,Ltd.All rights reserved.
#
# LiteOS NOVA is licensed under the Mulan PSL v1.
# You can use this software according to the terms and conditions of the Mulan PSL v1.
# You may obtain a copy of Mulan PSL v1 at:
#
# 	http://license.coscl.org.cn/MulanPSL
#
# THIS SOFTWARE IS PROVIDED ON AN "AS IS" BASIS, WITHOUT WARRANTIES OF ANY KIND, EITHER
# EXPRESS OR IMPLIED, INCLUDING BUT NOT LIMITED TO NON-INFRINGEMENT, MERCHANTABILITY OR
# FIT FOR A PARTICULAR PURPOSE.
# See the Mulan PSL v1 for more details.
#

config LINK_TYPE
    string "Linkage type, ROM or RAM"
    default "rom"

config ROM_START
    hex "rom start adddress"
    default 0x00000000

config ROM_SIZE
    hex "rom size"
    default 0x00000000

config RAM_START
    hex "ram start adddress"
    default 0x00000000

config RAM_SIZE
    hex "ram size"
    default 0x00000000

config EXTRA_RAM0
    bool "Enable extra ram region 0."
    default n

config EXTRA_RAM0_START
    hex "Extra RAM0 start."
    default 0x00000000

config EXTRA_RAM0_SIZE
    hex "Extra RAM0 size."
    default 0x00000000

config EXTRA_RAM1
    bool "Enable extra ram region 1."
    default n

config EXTRA_RAM1_START
    hex "Extra RAM1 start."
    default 0x00000000

config EXTRA_RAM1_SIZE
    hex "Extra RAM1 size."
    default 0x00000000

config EXTRA_RAM2
    bool "Enable extra ram region 2."
    default n

config EXTRA_RAM2_START
    hex "Extra RAM2 start."
    default 0x00000000

config EXTRA_RAM2_SIZE
    hex "Extra RAM2 size."
    default 0x00000000

config MAIN_TASK_PRIO
    int "The priority of the main task."
    default 20

config MAIN_TASK_OPTIONS
    int "The options of the main task."
    default 0

config MAIN_TASK_STACK_SIZE
    hex "The stack size of the main task."
    default 0x800
```

## iot_link/os/novaos/target/platform/nrf/kconfig
```kconfig
#
# Copyright (c) [2019] Huawei Technologies Co.,Ltd.All rights reserved.
#
# LiteOS NOVA is licensed under the Mulan PSL v1.
# You can use this software according to the terms and conditions of the Mulan PSL v1.
# You may obtain a copy of Mulan PSL v1 at:
#
# 	http://license.coscl.org.cn/MulanPSL
#
# THIS SOFTWARE IS PROVIDED ON AN "AS IS" BASIS, WITHOUT WARRANTIES OF ANY KIND, EITHER
# EXPRESS OR IMPLIED, INCLUDING BUT NOT LIMITED TO NON-INFRINGEMENT, MERCHANTABILITY OR
# FIT FOR A PARTICULAR PURPOSE.
# See the Mulan PSL v1 for more details.
#

config NRF
    def_bool n

if NRF

#
# and vendor specified drivers
#

# nordic UART

config NRF_UART
    def_bool n

# nordic UART#2

config NRF_UART0
    bool "Enable nordic UART#0."
    default n
    select NRF_UART

config NRF_UART0_TX_PIN
    int "nordic UART#0 tx pin number"
    depends on NRF_UART0

config NRF_UART0_RX_PIN
    int "nordic UART#0 rx pin number"
    depends on NRF_UART0

config NRF_UART0_REGBASE
    hex "nordic UART#0 register base"
    depends on NRF_UART0

config NRF_UART0_IRQN
    int "nordic UART#0 IRQ number"
    depends on NRF_UART0

# nordic UART#1

config NRF_UART1
    bool "Enable nordic UART#1."
    default n
    select NRF_UART

config NRF_UART1_TX_PIN
    int "nordic UART#1 tx pin number"
    depends on NRF_UART1

config NRF_UART1_RX_PIN
    int "nordic UART#1 rx pin number"
    depends on NRF_UART1

config NRF_UART1_REGBASE
    hex "nordic UART#1 register base"
    depends on NRF_UART1

config NRF_UART1_IRQN
    int "nordic UART#1 IRQ number"
    depends on NRF_UART1

# nordic RTC

config NRF_RTC
    def_bool n

config NRF_RTC0
    bool "Enable nordic RTC#0."
    default n
    select NRF_RTC

config NRF_RTC0_REGBASE
    hex "nordic RTC#0 register base"
    depends on NRF_RTC0

config NRF_RTC0_IRQN
    int "nordic RTC#0 IRQ number"
    depends on NRF_RTC0

config NRF_RTC1
    bool "Enable nordic RTC#1."
    default n
    select NRF_RTC

config NRF_RTC1_REGBASE
    hex "nordic RTC#1 register base"
    depends on NRF_RTC1

config NRF_RTC1_IRQN
    int "nordic RTC#1 IRQ number"
    depends on NRF_RTC1

endif
```
