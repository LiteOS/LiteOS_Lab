## iot_link/os/novaos/target/platform/stm32/kconfig
```kconfig
#
# Copyright (c) [2019] Huawei Technologies Co.,Ltd.All rights reserved.
#
# LiteOS NOVA is licensed under the Mulan PSL v1.
# You can use this software according to the terms and conditions of the Mulan PSL v1.
# You may obtain a copy of Mulan PSL v1 at:
#
# 	http://license.coscl.org.cn/MulanPSL
#
# THIS SOFTWARE IS PROVIDED ON AN "AS IS" BASIS, WITHOUT WARRANTIES OF ANY KIND, EITHER
# EXPRESS OR IMPLIED, INCLUDING BUT NOT LIMITED TO NON-INFRINGEMENT, MERCHANTABILITY OR
# FIT FOR A PARTICULAR PURPOSE.
# See the Mulan PSL v1 for more details.
#

config STM32
    def_bool n

if STM32

config STM32_HAL_H
    string "STM32 HAL header file name (stm32l4xx_hal.h, stm32f4xx_hal.h etc.)"
    default ""

config STM32_DMA
    def_bool n

config STM32_RCC
    def_bool y

config STM32_GPIO
    def_bool y

#
# STM32 UART
#

config STM32_UART
    def_bool n
    select STM32_DMA
    select HAL_UART

config STM32_UART_USING_DR
    bool "Specific if the UARTs are recieving/sending data by using the <DR> register."
    default n

# STM32 UART1

config STM32_UART1
    bool "Enable STM32 UART#1."
    default n
    select STM32_UART

if STM32_UART1

config STM32_UART1_BAUDRATE
    int "STM32 UART1 baudrate."
    default 115200

config STM32_UART1_TX_GPIOX
    int "STM32 UART1 TX PIN GPIO BASE, (0-GPIOA, 1-GPIOB, ...)."
    default 0

config STM32_UART1_TX_PIN
    int "STM32 UART1 TX PIN."
    default 9

config STM32_UART1_RX_GPIOX
    int "STM32 UART1 RX PIN GPIO BASE, (0-GPIOA, 1-GPIOB, ...)."
    default 0

config STM32_UART1_RX_PIN
    int "STM32 UART1 RX PIN."
    default 10

config STM32_UART1_AF
    int "STM32 UART1 alternate function mapping"
    default 7

endif

# STM32 UART2

config STM32_UART2
    bool "Enable STM32 UART#2."
    default n
    select STM32_UART

if STM32_UART2

config STM32_UART2_BAUDRATE
    int "STM32 UART2 baudrate."
    default 115200

config STM32_UART2_TX_GPIOX
    int "STM32 UART2 TX PIN GPIO BASE, (0-GPIOA, 1-GPIOB, ...)."
    default 0

config STM32_UART2_TX_PIN
    int "STM32 UART2 TX PIN."
    default 2

config STM32_UART2_RX_GPIOX
    int "STM32 UART2 RX PIN GPIO BASE, (0-GPIOA, 1-GPIOB, ...)."
    default 0

config STM32_UART2_RX_PIN
    int "STM32 UART2 RX PIN."
    default 3

config STM32_UART2_AF
    int "STM32 UART2 alternate function mapping"
    default 7

endif

# STM32 UART3

config STM32_UART3
    bool "Enable STM32 UART#3."
    default n
    select STM32_UART

if STM32_UART3

config STM32_UART3_BAUDRATE
    int "STM32 UART3 baudrate."
    default 115200

config STM32_UART3_TX_GPIOX
    int "STM32 UART3 TX PIN GPIO BASE, (0-GPIOA, 1-GPIOB, ...)."
    default 2

config STM32_UART3_TX_PIN
    int "STM32 UART3 TX PIN."
    default 4

config STM32_UART3_RX_GPIOX
    int "STM32 UART3 RX PIN GPIO BASE, (0-GPIOA, 1-GPIOB, ...)."
    default 2

config STM32_UART3_RX_PIN
    int "STM32 UART3 RX PIN."
    default 5

config STM32_UART3_AF
    int "STM32 UART3 alternate function mapping"
    default 7

endif

# STM32 LPUART1

config STM32_LPUART1
    bool "Enable STM32 LPUART#1."
    default n
    select STM32_UART

if STM32_LPUART1

config STM32_LPUART1_BAUDRATE
    int "STM32 LPUART1 baudrate."
    default 9600

config STM32_LPUART1_TX_GPIOX
    int "STM32 LPUART1_ TX PIN GPIO BASE, (0-GPIOA, 1-GPIOB, ...)."
    default 2

config STM32_LPUART1_TX_PIN
    int "STM32 LPUART1 TX PIN."
    default 0

config STM32_LPUART1_RX_GPIOX
    int "STM32 LPUART1 RX PIN GPIO BASE, (0-GPIOA, 1-GPIOB, ...)."
    default 2

config STM32_LPUART1_RX_PIN
    int "STM32 LPUART1 RX PIN."
    default 1

config STM32_LPUART1_AF
    int "STM32 LPUART1 alternate function mapping"
    default 8

endif

#
# STM32 I2C
#

config STM32_I2C
    def_bool n
    select HAL_I2C

# STM32_I2C1

config STM32_I2C1
    bool "STM32 I2C#1."
    default n
    select STM32_I2C

if STM32_I2C1

config STM32_I2C1_SCL_GPIOX
    int "STM32 I2C1 SCL PIN GPIO BASE, (0-GPIOA, 1-GPIOB, ...)."
    default 1

config STM32_I2C1_SCL_PIN
    int "STM32 I2C1 SCL PIN."
    default 6

config STM32_I2C1_SDA_GPIOX
    int "STM32 I2C1 SCL PIN GPIO BASE, (0-GPIOA, 1-GPIOB, ...)."
    default 1

config STM32_I2C1_SDA_PIN
    int "STM32 I2C1 SDA PIN."
    default 7

config STM32_I2C1_AF
    int "STM32 I2C1 alternate function mapping"
    default 4

endif

# STM32_I2C2

config STM32_I2C2
    bool "STM32 I2C#2."
    default n
    select STM32_I2C

if STM32_I2C2

config STM32_I2C2_SCL_GPIOX
    int "STM32 I2C2 SCL PIN GPIO BASE, (0-GPIOA, 1-GPIOB, ...)."
    default 1

config STM32_I2C2_SCL_PIN
    int "STM32 I2C2 SCL PIN."
    default 10

config STM32_I2C2_SDA_GPIOX
    int "STM32 I2C2 SCL PIN GPIO BASE, (0-GPIOA, 1-GPIOB, ...)."
    default 1

config STM32_I2C2_SDA_PIN
    int "STM32 I2C2 SDA PIN."
    default 14

config STM32_I2C2_AF
    int "STM32 I2C2 alternate function mapping"
    default 4

endif

# STM32_I2C3

config STM32_I2C3
    bool "STM32 I2C#3."
    default n
    select STM32_I2C

if STM32_I2C3

config STM32_I2C3_SCL_GPIOX
    int "STM32 I2C3 SCL PIN GPIO BASE, (0-GPIOA, 1-GPIOB, ...)."
    default 0

config STM32_I2C3_SCL_PIN
    int "STM32 I2C3 SCL PIN."
    default 7

config STM32_I2C3_SDA_GPIOX
    int "STM32 I2C3 SCL PIN GPIO BASE, (0-GPIOA, 1-GPIOB, ...)."
    default 1

config STM32_I2C3_SDA_PIN
    int "STM32 I2C3 SDA PIN."
    default 4

config STM32_I2C3_AF
    int "STM32 I2C3 alternate function mapping"
    default 4

endif

#
# STM32 ETH
#

config STM32_ETH
    def_bool n

config STM32_ETH1
    bool "STM32 ETH#1"
    select STM32_ETH
    select LWIP
    select HARDWARE_CHECKSUM
    default n

config STM32_ETH1_MAC
    string "STM32 ETH#1 mac address."
    depends on STM32_ETH1
    default "00:80:e1:01:02:03"

# STM32_ETH1

endif

orsource "*/kconfig"
```

## iot_link/os/novaos/target/platform/stm32/stm32h7/kconfig
```kconfig
#
# Copyright (c) [2019] Huawei Technologies Co.,Ltd.All rights reserved.
#
# LiteOS NOVA is licensed under the Mulan PSL v1.
# You can use this software according to the terms and conditions of the Mulan PSL v1.
# You may obtain a copy of Mulan PSL v1 at:
#
# 	http://license.coscl.org.cn/MulanPSL
#
# THIS SOFTWARE IS PROVIDED ON AN "AS IS" BASIS, WITHOUT WARRANTIES OF ANY KIND, EITHER
# EXPRESS OR IMPLIED, INCLUDING BUT NOT LIMITED TO NON-INFRINGEMENT, MERCHANTABILITY OR
# FIT FOR A PARTICULAR PURPOSE.
# See the Mulan PSL v1 for more details.
#

config STM32H7
    def_bool n
    select CORTEX_M7F
    select STM32
    select HAS_MPU
```

## iot_link/os/novaos/test/kconfig
```kconfig
#
# Copyright (c) [2019] Huawei Technologies Co.,Ltd.All rights reserved.
#
# LiteOS NOVA is licensed under the Mulan PSL v1.
# You can use this software according to the terms and conditions of the Mulan PSL v1.
# You may obtain a copy of Mulan PSL v1 at:
#
# 	http://license.coscl.org.cn/MulanPSL
#
# THIS SOFTWARE IS PROVIDED ON AN "AS IS" BASIS, WITHOUT WARRANTIES OF ANY KIND, EITHER
# EXPRESS OR IMPLIED, INCLUDING BUT NOT LIMITED TO NON-INFRINGEMENT, MERCHANTABILITY OR
# FIT FOR A PARTICULAR PURPOSE.
# See the Mulan PSL v1 for more details.
#

menu "LiteOS NOVA tests, demos"

config HEAP_UT
    bool "heap test code"
    default n

config EVENT_UT
    bool "event test code"
    default n

config MUTEX_UT
    bool "mutex test code"
    default n

config MEMTRY_UT
    bool "memtry test code"
    default n

config MQ_UT
    bool "message queue test code"
    default n

config PAGE_POOL_UT
    bool "page pool test code"
    select PAGE_POOL
    default n

config RING_UT
    bool "ring test code"
    default n

config TASK_UT_ARM
    def_bool y
    depends on TASK_UT && (AARCH_M || AARCH_32)

config TASK_UT
    bool "task test code"
    default n

config TICK_Q_UT
    bool "tick_q test code"
    default n

config SOFT_TIMER_UT
    bool "software timer test code"
    default n

config HOOK_UT
    bool "task hook test code"
    select TASK_CREATE_HOOK
    select TASK_DELETE_HOOK
    select TASK_SWITCH_HOOK
    default n

config TLS_UT
    bool "task local storage test code"
    select TASK_TLS
    default n

config MEMPOOL_UT
    bool "memory pool test code"
    default n

config TRACE_UT
    bool "stack trace test code"
    default n

config BH1750_UT
    bool "bh1750 test code"
    depends on BH1750 
    default n

endmenu
```

## iot_link/os/novaos/utils/kconfig
```kconfig
#
# Copyright (c) [2019] Huawei Technologies Co.,Ltd.All rights reserved.
#
# LiteOS NOVA is licensed under the Mulan PSL v1.
# You can use this software according to the terms and conditions of the Mulan PSL v1.
# You may obtain a copy of Mulan PSL v1 at:
#
# 	http://license.coscl.org.cn/MulanPSL
#
# THIS SOFTWARE IS PROVIDED ON AN "AS IS" BASIS, WITHOUT WARRANTIES OF ANY KIND, EITHER
# EXPRESS OR IMPLIED, INCLUDING BUT NOT LIMITED TO NON-INFRINGEMENT, MERCHANTABILITY OR
# FIT FOR A PARTICULAR PURPOSE.
# See the Mulan PSL v1 for more details.
#

menu "LiteOS NOVA utils configuration"

config DEBUG
    bool "Enable debug information"
    select KPRINTF
    default y

endmenu
```

## link_ota/download_check/Kconfig
```kconfig
#
# Copyright (c) [2020] Huawei Technologies Co.,Ltd.All rights reserved.
#
# LiteOS NOVA is licensed under the Mulan PSL v1.
# You can use this software according to the terms and conditions of the Mulan PSL v1.
# You may obtain a copy of Mulan PSL v1 at:
#
#   http://license.coscl.org.cn/MulanPSL
#
# THIS SOFTWARE IS PROVIDED ON AN "AS IS" BASIS, WITHOUT WARRANTIES OF ANY KIND, EITHER
# EXPRESS OR IMPLIED, INCLUDING BUT NOT LIMITED TO NON-INFRINGEMENT, MERCHANTABILITY OR
# FIT FOR A PARTICULAR PURPOSE.
# See the Mulan PSL v1 for more details.
#
config OTA_SHA256CHECK_ENABLE
    bool "Enable the SHA256 check component"
    default n
    depends on MBEDTLS_ENABLE
       
config OTA_SIGN_ENABLE
    bool "Enable the signature  component"
    default n
    select MBEDTLS_ENABLE

config OTA_SIGNVERIFY_ENABLE
    bool "Enable the signature verify component"
    default n
    select MBEDTLS_ENABLE  
    
config OTA_SIGN_TEST
    bool "Add the sign and sign_verify test to shell"
    default n
    select OTA_SIGN_ENABLE
    select OTA_SIGNVERIFY_ENABLE      
      
    
```

## targets/GD32F303_BearPi/Demos/Kconfig
```kconfig
config USER_APP
    bool "USER_APP Enable"
    default y
    
if USER_APP
choice Demo
	optional
	prompt "User Defined Demo"
	config Demo_None
		bool "none"
	config Demo_Helloworld
		bool "Hello World"
		select SHELL_ENABLE
	config Demo_Streetlight
		bool "OC Streetlight"
		select OC_LWM2M
		select SHELL_ENABLE
		select AT_ENABLE
		select BOUDICA150
		select STIMER_ENABLE
	config Demo_Agriculture
		bool "OC Agriculture"
		select OC_LWM2M
		select SHELL_ENABLE
		select AT_ENABLE
		select BOUDICA150
		select STIMER_ENABLE
	config Demo_Track
		bool "OC Track"
		select OC_LWM2M
		select SHELL_ENABLE
		select AT_ENABLE
		select BOUDICA150
		select STIMER_ENABLE
	config Demo_Smoke
		bool "OC Smoke"
		select OC_LWM2M
		select SHELL_ENABLE
		select AT_ENABLE
		select BOUDICA150
		select STIMER_ENABLE
	config Demo_OC_Cloud_Map
		bool "OC Cloud Map"
		select OC_LWM2M
		select SHELL_ENABLE
		select AT_ENABLE
		select BOUDICA150
		select STIMER_ENABLE
    config OCMQTT_APP
        bool "OCMQTT APP"
        select OC_MQTT_V5
        select OC_MQTTV5_PROFILE
        select E53_SC1
        
    config OCLWM2M_APP
        bool "OCLWM2M_APP"
        select OCLWM2M_ENABLE
        select E53_SC1
        
    
    config OCCOAP_APP
        bool "OCCOAP_APP"
        select OCCOAP_ENABLE  
        select E53_SC1
             	
endchoice

if OCLWM2M_APP
    config OCLWM2M_APP_DTLSMODE
        bool "Enable the dtls mode"
        default n
endif

if OCCOAP_APP
    config OCCOAP_APP_DTLSMODE
        bool "Enble the dtls mode"
        default n

endif




endif

config USER_DEMO
	string
	default "hello_world_demo" if Demo_Helloworld
	default "oc_streetlight_template" if Demo_Streetlight
	default "oc_agriculture_template" if Demo_Agriculture
	default "oc_track_template" if Demo_Track
	default "oc_smoke_template" if Demo_Smoke
	default "oc_cloud_map_demo" if Demo_OC_Cloud_Map
	default "none"
```

## targets/GD32F303_BearPi/Hardware/Kconfig
```kconfig
################################################################################
# this is used for compile the user defined oc demo
################################################################################
config ATUART_ENABLE
    bool "UART FOR AT"
    default n
if ATUART_ENABLE
    config UARTAT_RCVMAX
    int  "Config the at uart receive buffer size"
    default 2048

    config UARTAT_BAUDRATE
        int  "Config the at uart baud rate"
        default 115200
        
    config UARTAT_DEVNAME
        string "Config the at uart device name"
        default "atdev"
endif


config E53_IA1
    bool "E53_IA1 Enable"
    default n
    
config E53_SC1
    bool "E53_SC1 Enable"
    default n
    
config E53_SF1
    bool "E53_IA1 Enable"
    default n
    
config E53_ST1
    bool "E53_IA1 Enable"
    default n

config LCD_ENABLE
    bool "LCD enable"
    default y
```

## targets/GD32F303_BearPi/Kconfig
```kconfig
#
# Copyright (c) [2020] Huawei Technologies Co.,Ltd.All rights reserved.
#
# LiteOS NOVA is licensed under the Mulan PSL v1.
# You can use this software according to the terms and conditions of the Mulan PSL v1.
# You may obtain a copy of Mulan PSL v1 at:
#
#   http://license.coscl.org.cn/MulanPSL
#
# THIS SOFTWARE IS PROVIDED ON AN "AS IS" BASIS, WITHOUT WARRANTIES OF ANY KIND, EITHER
# EXPRESS OR IMPLIED, INCLUDING BUT NOT LIMITED TO NON-INFRINGEMENT, MERCHANTABILITY OR
# FIT FOR A PARTICULAR PURPOSE.
# See the Mulan PSL v1 for more details.
#

menu "LiteOS for GD32F303 Project configuration For IoT Link"

comment "This is a demo project and hope you enjoy it"

config ARCH_CPU_TYPE
   string "Select the cpu arch:armv7-m armv6-m riscv32 x86-64"
   default "armv7-m"
  
rsource "./Demos/Kconfig" 
rsource "./Hardware/Kconfig"       
         
rsource "../../iot_link/Kconfig"
    
endmenu
```

## targets/GD32VF103V_EVAL/Demos/Kconfig
```kconfig
choice Demo
	optional
	prompt "User Defined Demo"
	config Demo_None
		bool "none"
	config Demo_Helloworld
		bool "Hello World"
		select SHELL_ENABLE
	config Demo_Develop
		bool "OC develop"
		select OC_MQTT
                select CJSON
		select EC20
	config Demo_Oceanlink
		bool "OC Oceanlink"
		select OC_MQTT
                select CJSON
		select EC20
endchoice

config USER_DEMO
	string
	default "hello_world_demo" if Demo_Helloworld
	default "oc_develop_demo" if Demo_Develop
	default "oc_oceanlink_demo" if Demo_Oceanlink
	default "none"
```
