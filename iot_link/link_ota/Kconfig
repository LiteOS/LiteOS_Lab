## iot_link/link_ota/Kconfig
```kconfig
#
# Copyright (c) [2020] Huawei Technologies Co.,Ltd.All rights reserved.
#
# LiteOS NOVA is licensed under the Mulan PSL v1.
# You can use this software according to the terms and conditions of the Mulan PSL v1.
# You may obtain a copy of Mulan PSL v1 at:
#
#   http://license.coscl.org.cn/MulanPSL
#
# THIS SOFTWARE IS PROVIDED ON AN "AS IS" BASIS, WITHOUT WARRANTIES OF ANY KIND, EITHER
# EXPRESS OR IMPLIED, INCLUDING BUT NOT LIMITED TO NON-INFRINGEMENT, MERCHANTABILITY OR
# FIT FOR A PARTICULAR PURPOSE.
# See the Mulan PSL v1 for more details.
#

menu "OTA"

#OTA_ENABLE ONLY ENABLE THE IMG COMPONENTS, AND  THIS NEEDED BY THE FOTA OR SOTA DOWNLOAD RPOCESS
#OTA_PATCH, SUPPLY THE METHOD DO THE BACKUP UPGRADE RECOVER, THE LOADER NEED THIS

config OTA_ENABLE
    bool  "Enable the Link OTA"
    default y

if OTA_ENABLE
    config OTA_VERSIONLEN
        int  "Version string length"
        default 32
    config OTA_PATCH
        bool "Enable the img patch"
        default n 
    config OTA_IMG_CHECK
        bool "Do the Img RW TEST CHECK"
        default n
        
    config OTA_IMG_CHECKSOTA
        bool "Do the Img SOTA check"
        default n
        depends on OTA_IMG_CHECK
        
    config OTA_IMG_CHECK_BLOCKSIZE
        int  "Check Buffer Size"
        default 1024
        depends on OTA_IMG_CHECK
        
    config OTA_IMG_DEMO
        bool "Img simulated"
        default y   
        
    config OTA_IMG_MEMORY
        bool "Img simulated by memory"
        default n
        depends on OTA_IMG_DEMO
        
    config OTA_IMG_NULL
        bool "Img just PRINT"
        default y
        depends on OTA_IMG_DEMO
            
                          
endif                  
endmenu
```

## iot_link/link_ota/download/Kconfig
```kconfig
#
# Copyright (c) [2020] Huawei Technologies Co.,Ltd.All rights reserved.
#
# LiteOS NOVA is licensed under the Mulan PSL v1.
# You can use this software according to the terms and conditions of the Mulan PSL v1.
# You may obtain a copy of Mulan PSL v1 at:
#
#   http://license.coscl.org.cn/MulanPSL
#
# THIS SOFTWARE IS PROVIDED ON AN "AS IS" BASIS, WITHOUT WARRANTIES OF ANY KIND, EITHER
# EXPRESS OR IMPLIED, INCLUDING BUT NOT LIMITED TO NON-INFRINGEMENT, MERCHANTABILITY OR
# FIT FOR A PARTICULAR PURPOSE.
# See the Mulan PSL v1 for more details.
#

config OTA_DOWNLOAD_HTTPS
    bool "Enable the https download method"
    default n

if OTA_DOWNLOAD_HTTPS    

    config HTTPS_DOWNLOADING_SHA256CHECK
        bool "Enable the https download file sha256 check"
        default n
        select OTA_SHA256CHECK_ENABLE
    
    config HTTPS_DOWNGLOADING_SIGNCHECK
        bool "Enable the https download file signature check"
        default n
        select OTA_SIGNVERIFY_ENABLE
    config HTTPS_DOWNGLOADING_TRYTIMES
        int "Https try times when disconnect while downloading"
        default 24
    config HTTPS_DOWNGLOADING_RWTIMEOUT
        int "Https receive or send timeout(ms)"
        default 10000
    config HTTPS_DOWNGLOADING_BLKLEN
        int "Https receive BLOCK SIZE"
        default 1024 
endif        
        
        
```

## iot_link/os/novaos/arch/aarch-m/kconfig
```kconfig
#
# Copyright (c) [2019] Huawei Technologies Co.,Ltd.All rights reserved.
#
# LiteOS NOVA is licensed under the Mulan PSL v1.
# You can use this software according to the terms and conditions of the Mulan PSL v1.
# You may obtain a copy of Mulan PSL v1 at:
#
# 	http://license.coscl.org.cn/MulanPSL
#
# THIS SOFTWARE IS PROVIDED ON AN "AS IS" BASIS, WITHOUT WARRANTIES OF ANY KIND, EITHER
# EXPRESS OR IMPLIED, INCLUDING BUT NOT LIMITED TO NON-INFRINGEMENT, MERCHANTABILITY OR
# FIT FOR A PARTICULAR PURPOSE.
# See the Mulan PSL v1 for more details.
#

config AARCH_M_BASELINE
    def_bool n
    select AARCH_M

config AARCH_M_MAINLINE
    def_bool n
    select AARCH_M
    select AARCH_M_CBNZ_CBZ
    select AARCH_M_EXCLUSIVE
    select HAS_SYSTICK

config CORTEX_M0
    def_bool n
    select AARCH_M_BASELINE

config CORTEX_M0_PLUS
    def_bool n
    select AARCH_M_BASELINE

config CORTEX_M1
    def_bool n
    select AARCH_M_BASELINE

config CORTEX_M23
    def_bool n
    select AARCH_M_BASELINE

config CORTEX_M3
    def_bool n
    select AARCH_M_MAINLINE

config CORTEX_M4
    def_bool n
    select AARCH_M_MAINLINE

config CORTEX_M4F
    def_bool n
    select CORTEX_M4
    select HAS_FPU

config CORTEX_M7
    def_bool n
    select AARCH_M_MAINLINE

config CORTEX_M7F
    def_bool n
    select CORTEX_M7
    select HAS_FPU

config CORTEX_M33
    def_bool n
    select AARCH_M_MAINLINE

config CORTEX_M35P
    def_bool n
    select AARCH_M_MAINLINE

if AARCH_M

config HAS_VTOR
    bool
    default y if AARCH_M_MAINLINE || CORTEX_M0_PLUS
    default n

config AARCH_M_CBNZ_CBZ
    def_bool n

config AARCH_M_EXCLUSIVE
    def_bool n

# for now, all baseline core has 2 nvic prio bits including m0, m0+, m23
# for now, all mainline core has 4 nvic prio bits including m3, m4, m7, m3x
config NVIC_PRIO_BITS
    int
    default 2 if AARCH_M_BASELINE
    default 4 if AARCH_M_MAINLINE

config HAS_SYSTICK
    def_bool n

config SYSTICK
    bool "Enable SysTick timer."
    depends on HAS_SYSTICK
    default y

config HAS_MPU
    def_bool n
    depends on AARCH_M_MAINLINE || CORTEX_M0_PLUS

config MPU
    bool "Enable MPU support."
    depends on HAS_MPU
    select TASK_TLS
    select SWITCH_HOOK
    default n

config HAS_FPU
    def_bool n
    depends on AARCH_M_MAINLINE

config FPU
    bool "Enable FPU support."
    depends on HAS_FPU
    default y

config SVC
    bool "Enable SVCall support."
    select SYSCALL
    default y if MPU
    default n

config WFI
    bool "Use WFI in idle task."
    default y if TICKLESS
    default n

config TRACE
    bool "Enable trace support."
    depends on KPRINTF
    default y

# tools supported by aarch-m

config GNUC
    def_bool y

choice IDE_TYPE
    prompt "Please select the build tool used."
    default NOIDE

config NOIDE
    bool "no IDE support"

config KEIL
    bool "KEIL project"
    select IDE

config SESA
    bool "enable SEGGER Embedded Studio for ARM"
    select IDE
endchoice

config IDE_EXT
    string
    depends on !NOIDE
    default "uvprojx"   if KEIL
    default "emProject" if SESA

config IDE_NAME
    string
    depends on !NOIDE
    default "keil" if KEIL
    default "sesa" if SESA

menu "KEIL configuation"

config KEIL_DEVICE
    string "Device name in KEIL project."
    default ""

config KEIL_VENDOR
    string "Vendor name in KEIL project."
    default ""

config KEIL_CPU
    string "CPU information in KEIL project."
    default ""

config KEIL_TARGET_DLL_NAME
    string "Target DLL name in KEIL project."
    default ""

config KEIL_TARGET_DLL_ARG
    string "Target DLL arguments in KEIL project."
    default ""
    def_string "-MPU"

config KEIL_TARGET_DLG_DLL_NAME
    string "Target dialogue DLL name in KEIL project."
    default ""

config KEIL_TARGET_DLG_DLL_ARG
    string "Target dialogue DLL arguments in KEIL project."
    default ""

endmenu

menu "SESA configuation"

config SESA_ARCH
    string "Arch feild in KEIL project."
    default ""
config SESA_CORE
    string "Core feild in KEIL project."
    default ""
config SESA_ENDIAN
    string "Endian feild in KEIL project."
    default ""
config SESA_FP_ABI
    string "FP ABI feild in KEIL project."
    default ""
config SESA_FPU
    string "FPU feild in KEIL project."
    default ""
config SESA_DEVICE
    string "Device feild in KEIL project."
    default ""
config SESA_INTERFACE
    string "Debug interface in KEIL project."
    default ""
config SESA_SIMU_MEM_PARA
    string "Simulator memory parameter feild in KEIL project."
    default ""

endmenu

endif
```

## iot_link/os/novaos/arch/kconfig
```kconfig
#
# Copyright (c) [2019] Huawei Technologies Co.,Ltd.All rights reserved.
#
# LiteOS NOVA is licensed under the Mulan PSL v1.
# You can use this software according to the terms and conditions of the Mulan PSL v1.
# You may obtain a copy of Mulan PSL v1 at:
#
# 	http://license.coscl.org.cn/MulanPSL
#
# THIS SOFTWARE IS PROVIDED ON AN "AS IS" BASIS, WITHOUT WARRANTIES OF ANY KIND, EITHER
# EXPRESS OR IMPLIED, INCLUDING BUT NOT LIMITED TO NON-INFRINGEMENT, MERCHANTABILITY OR
# FIT FOR A PARTICULAR PURPOSE.
# See the Mulan PSL v1 for more details.
#

### all hiden, selected by BSP

config ARCH
    string
    default "aarch_m"  if AARCH_M
    default "aarch_32" if AARCH_32

config AARCH_M
    def_bool n

config AARCH_32
    def_bool n

menu "arch configuration"

config USER_APP
    bool "user application project"
    default n

# IDE is defined for all arches, the IDE select logic is defined in sub-arches,
# usually a kconfig selection
config IDE
    bool
    default n

rsource "*/kconfig"

config SYSTEM_CORE_CLOCK
    int "the system core clock frequence"

config NR_IRQS
    int "the number of IRQS"
    default 32

config IRQ_STACK_SIZE
    hex "the size of irq stack"
    default 0x800
endmenu
```

## iot_link/os/novaos/components/kconfig
```kconfig
#
# Copyright (c) [2019] Huawei Technologies Co.,Ltd.All rights reserved.
#
# LiteOS NOVA is licensed under the Mulan PSL v1.
# You can use this software according to the terms and conditions of the Mulan PSL v1.
# You may obtain a copy of Mulan PSL v1 at:
#
# 	http://license.coscl.org.cn/MulanPSL
#
# THIS SOFTWARE IS PROVIDED ON AN "AS IS" BASIS, WITHOUT WARRANTIES OF ANY KIND, EITHER
# EXPRESS OR IMPLIED, INCLUDING BUT NOT LIMITED TO NON-INFRINGEMENT, MERCHANTABILITY OR
# FIT FOR A PARTICULAR PURPOSE.
# See the Mulan PSL v1 for more details.
#

menu "LiteOS NOVA components configuration"

config CMDER
    bool "cmder shell"
    default y

config CMDER_UART
    bool "cmder shell over uart"
    depends on CMDER
    depends on HAL_UART
    default y

config CMDER_UART_NAME
    string "the uart device name used by cmder"
    depends on CMDER_UART
    default "uart0"

config CMDER_UART_HIS_CMD_BUFF_SIZE
    int "the uart history commder buffer size"
    depends on CMDER_UART
    default 256

config CMDER_UART_HIS_IDX_BUFF_SIZE
    int "the uart history index buffer size"
    depends on CMDER_UART
    default 64

config CMDER_UART_STACK_SIZE
    hex "the uart cmder task stack size"
    depends on CMDER_UART
    default 0x1000

config CMDER_TOP
    bool "Enable the command of \"top\"."
    depends on CMDER
    select PROFILE
    default n

config VFS
    bool "enable virtual filesystem switch support"
    default n

config DEVFS
    bool "enable device filesystem"
    default n
    select VFS

config MAX_FILE_NAME_LEN
    int "max file name length"
    default 16
    depends on VFS

config MAX_NR_FILES
    int "max file can be opened"
    default 32
    depends on VFS

config KPRINTF
    bool "add kprintf"
    default y
    depends on HAL_UART

config KPRINTF_UART_NAME
    string "the uart device name used by kprintf"
    depends on KPRINTF
    default CMDER_UART_NAME if CMDER_UART
    default "uart0"

config LWIP
    bool "Enable LWIP support."
    default n
    select IPC_MQ

orsource "*/kconfig"

endmenu
```

## iot_link/os/novaos/components/lwip/kconfig
```kconfig
#
# Copyright (c) [2019] Huawei Technologies Co.,Ltd.All rights reserved.
#
# LiteOS NOVA is licensed under the Mulan PSL v1.
# You can use this software according to the terms and conditions of the Mulan PSL v1.
# You may obtain a copy of Mulan PSL v1 at:
#
#      http://license.coscl.org.cn/MulanPSL
#
# THIS SOFTWARE IS PROVIDED ON AN "AS IS" BASIS, WITHOUT WARRANTIES OF ANY KIND, EITHER
# EXPRESS OR IMPLIED, INCLUDING BUT NOT LIMITED TO NON-INFRINGEMENT, MERCHANTABILITY OR
# FIT FOR A PARTICULAR PURPOSE.
# See the Mulan PSL v1 for more details.
#

if LWIP

config HARDWARE_CHECKSUM
    def_bool n

#
# LWIP TCPIP task attributes
#

config TCPIP_TASK_NAME
    string "The name of the lwip task."
    default "lwip"

config TCPIP_TASK_STACK_SIZE
    hex "The stack size of the lwip task."
    default 0x500

config TCPIP_TASK_PRIO
    int "The task priority of the lwip task."
    range 0 31
    default 1

#
# LWIP TCPIP MBOX attribute
#

config TCPIP_MBOX_SIZE
    int "The size of mail box."
    default 16

#
# LWIP feature selections
#

config PPP_SUPPORT
    bool "Enable PPP support."
    depends on NOT_SUPPORTED
    default n

config IPV6
    bool "Enable IPV6 support."
    depends on NOT_SUPPORTED
    default n

config MTU_VALUE
    int "The MTU value."
    range 64 1500
    default 1500

#
# adapter settings
#

config ETHIF_TASK_NAME
    string "ethif input task name."
    default "ethif"

config ETHIF_TASK_PRIO
    int "ethif input task priority."
    range 0 31
    default 2

config ETHIF_TASK_STACK_SIZE
    hex "ethif input task stack size."
    default 0x1000

endif
```

## iot_link/os/novaos/core/hal/kconfig
```kconfig
#
# Copyright (c) [2019] Huawei Technologies Co.,Ltd.All rights reserved.
#
# LiteOS NOVA is licensed under the Mulan PSL v1.
# You can use this software according to the terms and conditions of the Mulan PSL v1.
# You may obtain a copy of Mulan PSL v1 at:
#
# 	http://license.coscl.org.cn/MulanPSL
#
# THIS SOFTWARE IS PROVIDED ON AN "AS IS" BASIS, WITHOUT WARRANTIES OF ANY KIND, EITHER
# EXPRESS OR IMPLIED, INCLUDING BUT NOT LIMITED TO NON-INFRINGEMENT, MERCHANTABILITY OR
# FIT FOR A PARTICULAR PURPOSE.
# See the Mulan PSL v1 for more details.
#

menu "LiteOS NOVA hardware abstraction layer (hal) configuration"

# os core HAL UART configuration
config HAL_UART
    bool "HAL UART abstraction layer"
    default y

config HAL_I2C
    bool "HAL I2C abstraction layer"
    default n

endmenu
```
